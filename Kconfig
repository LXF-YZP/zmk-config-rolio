## Kconfig
```kconfig
# SPDX-License-Identifier: MIT
config INPUT_A320
    bool "Q20 ADBS-A320 optical trackpad"
    default y
    depends on DT_HAS_AVAGO_A320_ENABLED
    depends on I2C && ZMK_POINTING
    select INPUT
    select ZMK_HID_INDICATORS

if INPUT_A320

config INPUT_A320_POLLINGRATE
    int "Trackpad samples per second"
    default 100
    range 10 200

config TRACKPAD_SPEEDMULTIPLIER_HORIZONTAL
    int "Horizontal speed percentage (100 retains the original 1.5x gain)"
    default 100
    range 1 400

config TRACKPAD_SPEEDMULTIPLIER_VERTICAL
    int "Vertical speed percentage (100 retains the original 1.5x gain)"
    default 100
    range 1 400

config TRACKPAD_SCROLL_INTERVAL
    int "Polling interval in legacy lock-key scroll mode, in milliseconds"
    default 20
    range 5 100

endif
```

## boards/arm/zitaotech_q10/Kconfig
```kconfig
# Copyright (c) 2025 ZitaoTech
# SPDX-License-Identifier: MIT

if BOARD_ZITAOTECH_Q10

config BOARD_ENABLE_DCDC
    bool "Enable DCDC mode"
    select SOC_DCDC_NRF52X
    default y

menu "Backlight and LED options"

config TRACKPAD_LED_BRIGHTNESS
    int "Trackpad LED brightness when CapsLock is on"
    default 90
    range 0 100
    help
      The brightness value (0-100) to set the Trackpad LED when Caps Lock is active.

endmenu

menu "A320 Trackpad Setting"

config A320_TRACKPAD_SCROLL_INTERVAL
    int "Trackpad scroll in miliseconds"
    default 50
    range 0 200
    help
      The bigger this value, the slower the trackpad scrolls

config A320_TRACKPAD_SPEEDMULTIPLIER_VERTICAL
    int "Trackpad speed multiplier y"
    default 100
    range 1 100
    help
      from 1 to 100

config A320_TRACKPAD_SPEEDMULTIPLIER_HORIZONTAL
    int "Trackpad speed multiplier x"
    default 100
    range 1 100
    help
      from 1 to 100

config INPUT_A320_INIT_PRIORITY
    int "A320 trackpad init priority"
    default 90
    help
      Must be greater than the I2C and GPIO driver init priorities.

module = A320
module-str = a320
source "subsys/logging/Kconfig.template.log_config"

endmenu

endif # BOARD_ZITAOTECH_Q10
```

## boards/shields/bbq10_trackpad/Kconfig.defconfig
```kconfig
if SHIELD_BBQ10_TRACKPAD

config ZMK_KEYBOARD_NAME
    default "BBQ10 Trackpad"

endif
```

## boards/shields/bbq10_trackpad/Kconfig.shield
```kconfig
config SHIELD_BBQ10_TRACKPAD
    def_bool $(shields_list_contains,bbq10_trackpad)
```

## config/boards/shields/prospector_left_adapter/Kconfig.shield
```kconfig
config SHIELD_PROSPECTOR_LEFT_ADAPTER
    def_bool $(shields_list_contains,prospector_left_adapter)
```

## config/west.yml
```yaml
manifest:
  remotes:
    - name: zmkfirmware
      url-base: https://github.com/zmkfirmware
  projects:
    # 官方 v0.3 系列，固定版本以便复现 Studio 构建。
    # A320 驱动由本仓库的 Zephyr 模块提供，不再依赖旧 fork 的 main.c。
    - name: zmk
      remote: zmkfirmware
      revision: 3cf9006a9377f21c99e944e29e2a507d8c3e9069
      import: app/west.yml
  self:
    path: config
```

## dts/bindings/input/avago,a320.yaml
```yaml
# SPDX-License-Identifier: MIT
description: Avago ADBS-A320 optical trackpad, polled over I2C
compatible: "avago,a320"
include: i2c-device.yaml

properties:
  swap-xy:
    type: boolean
    description: Exchange X and Y before reporting pointer or scroll movement.
```

## dts/bindings/kscan/zmk,kscan-gpio-direct-active-low.yaml
```yaml
description: Direct GPIO KSCAN controller with active-low input support

compatible: "zmk,kscan-gpio-direct-active-low"

include: kscan.yaml

properties:
  input-gpios:
    type: phandle-array
    required: true
  debounce-press-ms:
    type: int
    default: 5
  debounce-release-ms:
    type: int
    default: 5
  poll-period-ms:
    type: int
    default: 5
```
